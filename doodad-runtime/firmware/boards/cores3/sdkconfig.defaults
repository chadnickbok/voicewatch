## doodad-runtime/firmware/boards/cores3/sdkconfig.defaults
```kconfig
CONFIG_DOODAD_BOARD_CORES3=y
# CONFIG_DOODAD_BOARD_TWATCH_S3 is not set
CONFIG_SPIRAM_MODE_QUAD=y
```

## doodad-runtime/firmware/boards/t-watch-s3/sdkconfig.defaults
```kconfig
# CONFIG_DOODAD_BOARD_CORES3 is not set
CONFIG_DOODAD_BOARD_TWATCH_S3=y
CONFIG_SPIRAM_MODE_OCT=y
```

## doodad-runtime/firmware/main/Kconfig.projbuild
```kconfig
menu "Doodad hardware"

choice DOODAD_BOARD
    prompt "Target board"
    default DOODAD_BOARD_CORES3

config DOODAD_BOARD_CORES3
    bool "M5Stack CoreS3 SE"

config DOODAD_BOARD_TWATCH_S3
    bool "LilyGO T-Watch S3"

config DOODAD_BOARD_TWATCH_ULTRA
    bool "LilyGO T-Watch Ultra (410x502, quad PSRAM)"

endchoice

endmenu

menu "Doodad networking"

config DOODAD_WIFI_SSID
    string "Wi-Fi SSID"
    default ""
    help
        Shared native Wi-Fi credentials. These remain outside Wasm guest
        memory. The legacy weather-specific values are used as a fallback.

config DOODAD_WIFI_PASSWORD
    string "Wi-Fi password"
    default ""

config DOODAD_TIMEZONE
    string "Local POSIX timezone"
    default "PST8PDT,M3.2.0,M11.1.0"
    help
        POSIX TZ string used by the system watch face after network time sync.
        The default observes Pacific time and its daylight-saving transitions.

endmenu

menu "Doodad voice uplink"

config DOODAD_VOICE_UPLINK
    bool "Enable voice control and media"
    default n
    help
        Connects to a local doodad-voice signaling service over WebSocket and
        sends mono audio through an Espressif PeerConnection.

if DOODAD_VOICE_UPLINK

choice DOODAD_VOICE_TRANSPORT
    prompt "Voice media transport"
    default DOODAD_VOICE_TRANSPORT_MOQ if DOODAD_BOARD_TWATCH_ULTRA
    default DOODAD_VOICE_TRANSPORT_WEBRTC

config DOODAD_VOICE_TRANSPORT_WEBRTC
    bool "Legacy WebRTC"

config DOODAD_VOICE_TRANSPORT_MOQ
    bool "Native MoQ/Hang (development)"
    depends on DOODAD_BOARD_TWATCH_ULTRA
    help
        Uses a dedicated bounded audio owner and authenticated session grants.
        A connected control WebSocket alone does not authorize a MoQ session.

endchoice

choice DOODAD_VOICE_CODEC
    prompt "WebRTC voice codec"
    default DOODAD_VOICE_CODEC_OPUS
    help
        Opus provides 16 kHz wideband speech. PCMU remains available as the
        narrowband diagnostic fallback used by the original bring-up path.

config DOODAD_VOICE_CODEC_OPUS
    bool "Opus wideband (recommended)"

config DOODAD_VOICE_CODEC_PCMU
    bool "PCMU 8 kHz fallback"
    depends on DOODAD_VOICE_TRANSPORT_WEBRTC

endchoice

config DOODAD_VOICE_SIGNALING_URL
    string "Static signaling WebSocket URL (optional)"
    default ""
    help
        Diagnostic override such as ws://192.168.1.10:8765/ws. When empty,
        firmware discovers _doodad-voice._tcp over mDNS.

config DOODAD_VOICE_SIGNALING_PORT
    int "Fallback signaling port"
    range 1 65535
    default 8765

config DOODAD_VOICE_AUTOCONNECT
    bool "Connect the voice transport at boot"
    default y
    help
        Useful for the unattended Echo Bridge hardware test. Capture still
        requires an explicit app or server command.

config DOODAD_SPEAKER_VOLUME
    int "Voice response speaker volume"
    range 0 255
    default 144
    help
        Normalized board speaker volume used for WebRTC voice responses.
        Keep this below full scale while validating clipping and distortion.

endif

endmenu

menu "Doodad personal apps"

config DOODAD_PERSONAL_APPS
    bool "Enable signed personal-app installation"
    default y
    help
        Accept owner-bound DDB1 bundles announced by the live-agent, download
        them over HTTP, and install them into the onboard package registry.
        This is the local-development trust profile, not a published-app PKI.

if DOODAD_PERSONAL_APPS

config DOODAD_PERSONAL_OWNER_ID
    string "Personal app owner ID"
    default ""
    help
        Stable local user identifier embedded in and verified against every
        personal bundle. It must match DOODAD_PERSONAL_OWNER_ID on the
        live-agent host.

config DOODAD_PERSONAL_SIGNER_KEY_ID
    string "Personal signer key ID"
    default "personal-v1"
    help
        Label for the shared local-development signing key. It is metadata,
        not a published-developer identity.

config DOODAD_PERSONAL_HMAC_KEY_HEX
    string "Personal HMAC key (hex)"
    default ""
    help
        Exactly 64 hexadecimal characters (32 bytes). It must match
        DOODAD_PERSONAL_HMAC_KEY_HEX on the live-agent host. Leaving either
        the owner or key empty disables new installs while preserving the
        native shell and already-installed registry.

config DOODAD_PERSONAL_HOST_ABI
    int "Supported personal-app host ABI"
    range 1 2147483647
    default 1

endif

endmenu

menu "Doodad Weather provider"

config DOODAD_WEATHER_NETWORK_PROVIDER
    bool "Enable the host-owned Open-Meteo provider"
    default n
    help
        Keeps networking outside Wasm and asynchronously normalizes one
        Open-Meteo forecast into weather.snapshot.v2. Disabled conformance
        builds continue to use deterministic fixtures.

if DOODAD_WEATHER_NETWORK_PROVIDER

config DOODAD_WEATHER_WIFI_SSID
    string "Wi-Fi SSID"
    default ""

config DOODAD_WEATHER_WIFI_PASSWORD
    string "Wi-Fi password"
    default ""

config DOODAD_WEATHER_LOCATION_NAME
    string "Display location"
    default "San Francisco"

config DOODAD_WEATHER_LATITUDE
    string "Latitude"
    default "37.774900"

config DOODAD_WEATHER_LONGITUDE
    string "Longitude"
    default "-122.419400"

config DOODAD_WEATHER_TIMEZONE
    string "Open-Meteo timezone"
    default "auto"
    help
        Use "auto" to resolve local forecast timestamps from the configured
        coordinates, or provide an IANA timezone such as America/Los_Angeles.

choice DOODAD_WEATHER_UNITS
    prompt "Weather units"
    default DOODAD_WEATHER_UNITS_IMPERIAL

config DOODAD_WEATHER_UNITS_METRIC
    bool "Metric"

config DOODAD_WEATHER_UNITS_IMPERIAL
    bool "Imperial"

endchoice

endif

endmenu
```
